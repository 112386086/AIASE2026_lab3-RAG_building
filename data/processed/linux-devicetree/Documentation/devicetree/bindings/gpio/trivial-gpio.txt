## data/processed/linux-devicetree/Documentation/devicetree/bindings/gpio/trivial-gpio.txt
```
The D-Bus interface specification for 'linux-devicetree/Documentation/devicetree/bindings/gpio/trivial-gpio.yaml' is defined as follows:
- $id: http://devicetree.org/schemas/gpio/trivial-gpio.yaml#
- $schema: http://devicetree.org/meta-schemas/core.yaml#
- title: Trivial 2-cell GPIO controllers
- maintainers:
  - Bartosz Golaszewski <brgl@bgdev.pl>
- properties:
  - compatible:
    - oneOf:
        - items:
            - enum:
              - cirrus,ep7312-gpio
            - const: cirrus,ep7209-gpio
        - enum:
          - apm,xgene-gpio
          - cirrus,ep7209-gpio
          - cznic,moxtet-gpio
          - dlg,slg7xl45106
          - fcs,fxl6408
          - gateworks,pld-gpio
          - ibm,ppc4xx-gpio
          - loongson,ls1x-gpio
          - maxim,max77620
          - nintendo,hollywood-gpio
          - nxp,pca9570
          - nxp,pca9571
          - rockchip,rk3328-grf-gpio
          - snps,creg-gpio-hsdk
          - technologic,ts4800-gpio
          - technologic,ts4900-gpio
          - technologic,ts7970-gpio
          - ti,741g125
          - ti,741g174
          - ti,742g125
          - ti,7474
          - ti,74125
          - ti,74175
          - ti,74365
          - ti,74174
          - ti,74244
          - ti,74273
          - ti,741624
          - ti,7416374
          - ti,lp3943-gpio
          - ti,palmas-gpio
          - ti,tpic2810
          - ti,tps80036-gpio
          - ti,tps65913-gpio
          - ti,tps65914-gpio
  - reg:
    - maxItems: 1
  - #gpio-cells:
    - const: 2
  - gpio-controller: True
  - gpio-line-names: True
  - ngpios: True
- patternProperties:
  - ^(hog-[0-9]+|.+-hog(-[0-9]+)?)$:
    - type: object
    - required:
      - gpio-hog
- required:
  - compatible
  - #gpio-cells
  - gpio-controller
- allOf:
    - if:
      - properties:
        - compatible:
          - contains:
            - enum:
              - maxim,max77620
              - rockchip,rk3328-grf-gpio
              - ti,lp3943-gpio
              - ti,palmas-gpio
              - ti,tps80036-gpio
              - ti,tps65913-gpio
              - ti,tps65914-gpio
    - then:
      - properties:
        - reg: False
    - else:
      - required:
        - reg
- additionalProperties: False
- examples:
  - gpio@1701c000 {
    compatible = "apm,xgene-gpio";
    reg = <0x1701c000 0x40>;
    gpio-controller;
    #gpio-cells = <2>;
};
```
