## data/processed/linux-devicetree/Documentation/devicetree/bindings/gpio/qcom,wcd934x-gpio.txt
```
The D-Bus interface specification for 'linux-devicetree/Documentation/devicetree/bindings/gpio/qcom,wcd934x-gpio.yaml' is defined as follows:
Description: Qualcomm Technologies Inc WCD9340/WCD9341 Audio Codec has integrated
gpio controller to control 5 gpios on the chip.
- $id: http://devicetree.org/schemas/gpio/qcom,wcd934x-gpio.yaml#
- $schema: http://devicetree.org/meta-schemas/core.yaml#
- title: WCD9340/WCD9341 GPIO controller
- maintainers:
  - Srinivas Kandagatla <srinivas.kandagatla@linaro.org>
- description: Qualcomm Technologies Inc WCD9340/WCD9341 Audio Codec has integrated
gpio controller to control 5 gpios on the chip.

- properties:
  - compatible:
    - enum:
      - qcom,wcd9340-gpio
      - qcom,wcd9341-gpio
  - reg:
    - maxItems: 1
  - gpio-controller: True
  - #gpio-cells:
    - const: 2
- required:
  - compatible
  - reg
  - gpio-controller
  - #gpio-cells
- additionalProperties: False
- examples:
  - wcdgpio: gpio@42 {
    compatible = "qcom,wcd9340-gpio";
    reg = <0x042 0x2>;
    gpio-controller;
    #gpio-cells = <2>;
};
```

## data/processed/linux-devicetree/Documentation/devicetree/bindings/gpio/renesas,rcar-gpio.txt
```
The D-Bus interface specification for 'linux-devicetree/Documentation/devicetree/bindings/gpio/renesas,rcar-gpio.yaml' is defined as follows:
- $id: http://devicetree.org/schemas/gpio/renesas,rcar-gpio.yaml#
- $schema: http://devicetree.org/meta-schemas/core.yaml#
- title: Renesas R-Car General-Purpose Input/Output Ports (GPIO)
- maintainers:
  - Geert Uytterhoeven <geert+renesas@glider.be>
- properties:
  - compatible:
    - oneOf:
        - items:
            - enum:
              - renesas,gpio-r8a7778
              - renesas,gpio-r8a7779
            - const: renesas,rcar-gen1-gpio
        - items:
            - enum:
              - renesas,gpio-r8a7742
              - renesas,gpio-r8a7743
              - renesas,gpio-r8a7744
              - renesas,gpio-r8a7745
              - renesas,gpio-r8a77470
              - renesas,gpio-r8a7790
              - renesas,gpio-r8a7791
              - renesas,gpio-r8a7792
              - renesas,gpio-r8a7793
              - renesas,gpio-r8a7794
            - const: renesas,rcar-gen2-gpio
        - items:
            - enum:
              - renesas,gpio-r8a774a1
              - renesas,gpio-r8a774b1
              - renesas,gpio-r8a774c0
              - renesas,gpio-r8a774e1
              - renesas,gpio-r8a7795
              - renesas,gpio-r8a7796
              - renesas,gpio-r8a77961
              - renesas,gpio-r8a77965
              - renesas,gpio-r8a77970
              - renesas,gpio-r8a77980
              - renesas,gpio-r8a77990
              - renesas,gpio-r8a77995
            - const: renesas,rcar-gen3-gpio
        - items:
            - enum:
              - renesas,gpio-r8a779a0
              - renesas,gpio-r8a779f0
              - renesas,gpio-r8a779g0
              - renesas,gpio-r8a779h0
            - const: renesas,rcar-gen4-gpio
  - reg:
    - maxItems: 1
  - interrupts:
    - maxItems: 1
  - clocks:
    - maxItems: 1
  - power-domains:
    - maxItems: 1
  - resets:
    - maxItems: 1
  - gpio-controller: True
  - #gpio-cells:
    - const: 2
  - interrupt-controller: True
  - #interrupt-cells:
    - const: 2
  - gpio-ranges:
    - maxItems: 1
  - gpio-reserved-ranges:
    - minItems: 1
    - maxItems: 8
- patternProperties:
  - ^.*$:
    - if:
      - type: object
    - then:
      - properties:
        - gpio-hog: True
        - gpios: True
        - input: True
        - output-high: True
        - output-low: True
        - line-name: True
      - required:
        - gpio-hog
        - gpios
      - additionalProperties: False
- required:
  - compatible
  - reg
  - interrupts
  - gpio-controller
  - #gpio-cells
  - gpio-ranges
  - interrupt-controller
  - #interrupt-cells
- if:
  - not:
    - properties:
      - compatible:
        - contains:
          - enum:
            - renesas,rcar-gen1-gpio
- then:
  - required:
    - clocks
    - power-domains
    - resets
- additionalProperties: False
- examples:
  - #include <dt-bindings/clock/r8a77470-cpg-mssr.h>
#include <dt-bindings/interrupt-controller/arm-gic.h>
#include <dt-bindings/power/r8a77470-sysc.h>
gpio3: gpio@e6053000 {
    compatible = "renesas,gpio-r8a77470", "renesas,rcar-gen2-gpio";
    reg = <0xe6053000 0x50>;
    interrupts = <GIC_SPI 7 IRQ_TYPE_LEVEL_HIGH>;
    clocks = <&cpg CPG_MOD 909>;
    power-domains = <&sysc R8A77470_PD_ALWAYS_ON>;
    resets = <&cpg 909>;
    gpio-controller;
    #gpio-cells = <2>;
    gpio-ranges = <&pfc 0 96 30>;
    gpio-reserved-ranges = <17 10>;
    interrupt-controller;
    #interrupt-cells = <2>;
 };
```

## data/processed/linux-devicetree/Documentation/devicetree/bindings/gpio/rockchip,gpio-bank.txt
```
The D-Bus interface specification for 'linux-devicetree/Documentation/devicetree/bindings/gpio/rockchip,gpio-bank.yaml' is defined as follows:
- $id: http://devicetree.org/schemas/gpio/rockchip,gpio-bank.yaml#
- $schema: http://devicetree.org/meta-schemas/core.yaml#
- title: Rockchip GPIO bank
- maintainers:
  - Heiko Stuebner <heiko@sntech.de>
- properties:
  - compatible:
    - enum:
      - rockchip,gpio-bank
      - rockchip,rk3188-gpio-bank0
  - reg:
    - maxItems: 1
  - interrupts:
    - maxItems: 1
  - clocks:
    - minItems: 1
    - items:
        - description: APB interface clock source
        - description: GPIO debounce reference clock source
  - gpio-ranges: True
  - gpio-controller: True
  - gpio-line-names: True
  - #gpio-cells:
    - const: 2
  - interrupt-controller: True
  - #interrupt-cells:
    - const: 2
  - power-domains:
    - maxItems: 1
- patternProperties:
  - ^.+-hog(-[0-9]+)?$:
    - type: object
    - required:
      - gpio-hog
- required:
  - compatible
  - reg
  - interrupts
  - clocks
  - gpio-controller
  - #gpio-cells
  - interrupt-controller
  - #interrupt-cells
- additionalProperties: False
- examples:
  - #include <dt-bindings/interrupt-controller/arm-gic.h>
pinctrl: pinctrl {
  #address-cells = <1>;
  #size-cells = <1>;
  ranges;

  gpio0: gpio@2000a000 {
    compatible = "rockchip,rk3188-gpio-bank0";
    reg = <0x2000a000 0x100>;
    interrupts = <GIC_SPI 54 IRQ_TYPE_LEVEL_HIGH>;
    clocks = <&clk_gates8 9>;

    gpio-controller;
    #gpio-cells = <2>;

    interrupt-controller;
    #interrupt-cells = <2>;
  };

  gpio1: gpio@2003c000 {
    compatible = "rockchip,gpio-bank";
    reg = <0x2003c000 0x100>;
    interrupts = <GIC_SPI 55 IRQ_TYPE_LEVEL_HIGH>;
    clocks = <&clk_gates8 10>;

    gpio-controller;
    #gpio-cells = <2>;

    interrupt-controller;
    #interrupt-cells = <2>;
  };
};
```

## data/processed/linux-devicetree/Documentation/devicetree/bindings/gpio/ti,keystone-dsp-gpio.txt
```
The D-Bus interface specification for 'linux-devicetree/Documentation/devicetree/bindings/gpio/ti,keystone-dsp-gpio.yaml' is defined as follows:
Description: HOST OS userland running on ARM can send interrupts to DSP cores using
the DSP GPIO controller IP. It provides 28 IRQ signals per each DSP core.
This is one of the component used by the IPC mechanism used on Keystone SOCs.

For example TCI6638K2K SoC has 8 DSP GPIO controllers:
 - 8 for C66x CorePacx CPUs 0-7

Keystone 2 DSP GPIO controller has specific features:
- each GPIO can be configured only as output pin;
- setting GPIO value to 1 causes IRQ generation on target DSP core;
- reading pin value returns 0 - if IRQ was handled or 1 - IRQ is still
  pending.
- $id: http://devicetree.org/schemas/gpio/ti,keystone-dsp-gpio.yaml#
- $schema: http://devicetree.org/meta-schemas/core.yaml#
- title: Keystone 2 DSP GPIO controller
- maintainers:
  - Grygorii Strashko <grygorii.strashko@ti.com>
- description: HOST OS userland running on ARM can send interrupts to DSP cores using
the DSP GPIO controller IP. It provides 28 IRQ signals per each DSP core.
This is one of the component used by the IPC mechanism used on Keystone SOCs.

For example TCI6638K2K SoC has 8 DSP GPIO controllers:
 - 8 for C66x CorePacx CPUs 0-7

Keystone 2 DSP GPIO controller has specific features:
- each GPIO can be configured only as output pin;
- setting GPIO value to 1 causes IRQ generation on target DSP core;
- reading pin value returns 0 - if IRQ was handled or 1 - IRQ is still
  pending.

- properties:
  - compatible:
    - const: ti,keystone-dsp-gpio
  - reg:
    - maxItems: 1
  - gpio-controller: True
  - #gpio-cells:
    - const: 2
  - gpio,syscon-dev:
    - description: Phandle and offset of device's specific registers within the syscon state control registers
    - $ref: /schemas/types.yaml#/definitions/phandle-array
    - items:
        - items:
            - description: phandle to syscon
            - description: register offset within state control registers
- required:
  - compatible
  - reg
  - gpio-controller
  - #gpio-cells
  - gpio,syscon-dev
- additionalProperties: False
- examples:
  - gpio@240 {
    compatible = "ti,keystone-dsp-gpio";
    reg = <0x240 0x4>;
    gpio-controller;
    #gpio-cells = <2>;
    gpio,syscon-dev = <&devctrl 0x240>;
};
```
