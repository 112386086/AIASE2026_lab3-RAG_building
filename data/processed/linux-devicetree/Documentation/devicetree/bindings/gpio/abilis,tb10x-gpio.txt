## data/processed/linux-devicetree/Documentation/devicetree/bindings/gpio/gpio-zynq.txt
```
The D-Bus interface specification for 'linux-devicetree/Documentation/devicetree/bindings/gpio/gpio-zynq.yaml' is defined as follows:
- $id: http://devicetree.org/schemas/gpio/gpio-zynq.yaml#
- $schema: http://devicetree.org/meta-schemas/core.yaml#
- title: Xilinx Zynq GPIO controller
- maintainers:
  - Michal Simek <michal.simek@amd.com>
- properties:
  - compatible:
    - enum:
      - xlnx,zynq-gpio-1.0
      - xlnx,zynqmp-gpio-1.0
      - xlnx,versal-gpio-1.0
      - xlnx,pmc-gpio-1.0
  - reg:
    - maxItems: 1
  - #gpio-cells:
    - const: 2
  - interrupts:
    - maxItems: 1
  - gpio-controller: True
  - gpio-line-names:
    - description: strings describing the names of each gpio line
    - minItems: 58
    - maxItems: 174
  - interrupt-controller: True
  - #interrupt-cells:
    - const: 2
  - clocks:
    - maxItems: 1
  - power-domains:
    - maxItems: 1
- allOf:
    - if:
      - properties:
        - compatible:
          - enum:
            - xlnx,zynqmp-gpio-1.0
    - then:
      - properties:
        - gpio-line-names:
          - minItems: 174
          - maxItems: 174
    - if:
      - properties:
        - compatible:
          - enum:
            - xlnx,zynq-gpio-1.0
    - then:
      - properties:
        - gpio-line-names:
          - minItems: 118
          - maxItems: 118
    - if:
      - properties:
        - compatible:
          - enum:
            - xlnx,versal-gpio-1.0
    - then:
      - properties:
        - gpio-line-names:
          - minItems: 58
          - maxItems: 58
    - if:
      - properties:
        - compatible:
          - enum:
            - xlnx,pmc-gpio-1.0
    - then:
      - properties:
        - gpio-line-names:
          - minItems: 116
          - maxItems: 116
- required:
  - compatible
  - reg
  - #gpio-cells
  - interrupts
  - gpio-controller
  - interrupt-controller
  - #interrupt-cells
  - clocks
- additionalProperties: False
- examples:
  - gpio@e000a000 {
  #gpio-cells = <2>;
  compatible = "xlnx,zynq-gpio-1.0";
  clocks = <&clkc 42>;
  gpio-controller;
  interrupt-parent = <&intc>;
  interrupts = <0 20 4>;
  interrupt-controller;
  #interrupt-cells = <2>;
  reg = <0xe000a000 0x1000>;
};
```

## data/processed/linux-devicetree/Documentation/devicetree/bindings/gpio/hisilicon,ascend910-gpio.txt
```
The D-Bus interface specification for 'linux-devicetree/Documentation/devicetree/bindings/gpio/hisilicon,ascend910-gpio.yaml' is defined as follows:
Description: The HiSilicon common GPIO controller can be used for many different types of SoC such as Huawei Ascend AI series chips.
- $id: http://devicetree.org/schemas/gpio/hisilicon,ascend910-gpio.yaml#
- $schema: http://devicetree.org/meta-schemas/core.yaml#
- title: HiSilicon common GPIO controller
- maintainers:
  - Jay Fang <f.fangjian@huawei.com>
- description: The HiSilicon common GPIO controller can be used for many different types of SoC such as Huawei Ascend AI series chips.
- properties:
  - compatible:
    - const: hisilicon,ascend910-gpio
  - reg:
    - maxItems: 1
  - interrupts:
    - maxItems: 1
  - gpio-controller: True
  - #gpio-cells:
    - const: 2
  - ngpios:
    - minimum: 1
    - maximum: 32
- required:
  - compatible
  - reg
  - interrupts
  - gpio-controller
  - #gpio-cells
  - ngpios
- additionalProperties: False
- examples:
  - #include <dt-bindings/interrupt-controller/arm-gic.h>

gpio@840d0000 {
  compatible = "hisilicon,ascend910-gpio";
  reg = <0x840d0000 0x1000>;
  ngpios = <32>;
  gpio-controller;
  #gpio-cells = <2>;
  interrupts = <GIC_SPI 33 IRQ_TYPE_LEVEL_HIGH>;
};
```

## data/processed/linux-devicetree/Documentation/devicetree/bindings/gpio/kontron,sl28cpld-gpio.txt
```
The D-Bus interface specification for 'linux-devicetree/Documentation/devicetree/bindings/gpio/kontron,sl28cpld-gpio.yaml' is defined as follows:
Description: This module is part of the sl28cpld multi-function device. For more
details see ../embedded-controller/kontron,sl28cpld.yaml.

There are three flavors of the GPIO controller, one full featured
input/output with interrupt support (kontron,sl28cpld-gpio), one
output-only (kontron,sl28-gpo) and one input-only (kontron,sl28-gpi).

Each controller supports 8 GPIO lines.
- $id: http://devicetree.org/schemas/gpio/kontron,sl28cpld-gpio.yaml#
- $schema: http://devicetree.org/meta-schemas/core.yaml#
- title: GPIO driver for the sl28cpld board management controller
- maintainers:
  - Michael Walle <michael@walle.cc>
- description: This module is part of the sl28cpld multi-function device. For more
details see ../embedded-controller/kontron,sl28cpld.yaml.

There are three flavors of the GPIO controller, one full featured
input/output with interrupt support (kontron,sl28cpld-gpio), one
output-only (kontron,sl28-gpo) and one input-only (kontron,sl28-gpi).

Each controller supports 8 GPIO lines.

- properties:
  - compatible:
    - enum:
      - kontron,sl28cpld-gpio
      - kontron,sl28cpld-gpi
      - kontron,sl28cpld-gpo
  - reg:
    - maxItems: 1
  - interrupts:
    - maxItems: 1
  - #interrupt-cells:
    - const: 2
  - interrupt-controller: True
  - #gpio-cells:
    - const: 2
  - gpio-controller: True
  - gpio-line-names:
    - minItems: 1
    - maxItems: 8
- required:
  - compatible
  - #gpio-cells
  - gpio-controller
- additionalProperties: False
```

## data/processed/linux-devicetree/Documentation/devicetree/bindings/gpio/lsi,zevio-gpio.txt
```
The D-Bus interface specification for 'linux-devicetree/Documentation/devicetree/bindings/gpio/lsi,zevio-gpio.yaml' is defined as follows:
- $id: http://devicetree.org/schemas/gpio/lsi,zevio-gpio.yaml#
- $schema: http://devicetree.org/meta-schemas/core.yaml#
- title: Zevio GPIO controller
- maintainers:
  - Pratik Farkase <pratikfarkase94@gmail.com>
- properties:
  - compatible:
    - items:
        - const: lsi,zevio-gpio
  - reg:
    - maxItems: 1
  - interrupts:
    - maxItems: 1
  - #gpio-cells:
    - const: 2
  - gpio-controller: True
- required:
  - compatible
  - reg
  - #gpio-cells
  - gpio-controller
- unevaluatedProperties: False
- examples:
  - gpio@90000000 {
    compatible = "lsi,zevio-gpio";
    reg = <0x90000000 0x1000>;
    gpio-controller;
    #gpio-cells = <2>;
};
```

## data/processed/linux-devicetree/Documentation/devicetree/bindings/gpio/maxim,max77759-gpio.txt
```
The D-Bus interface specification for 'linux-devicetree/Documentation/devicetree/bindings/gpio/maxim,max77759-gpio.yaml' is defined as follows:
Description: This module is part of the MAX77759 PMIC. For additional information, see
Documentation/devicetree/bindings/mfd/maxim,max77759.yaml.

The MAX77759 is a PMIC integrating, amongst others, a GPIO controller
including interrupt support for 2 GPIO lines.
- $id: http://devicetree.org/schemas/gpio/maxim,max77759-gpio.yaml#
- $schema: http://devicetree.org/meta-schemas/core.yaml#
- title: Maxim Integrated MAX77759 GPIO
- maintainers:
  - André Draszik <andre.draszik@linaro.org>
- description: This module is part of the MAX77759 PMIC. For additional information, see
Documentation/devicetree/bindings/mfd/maxim,max77759.yaml.

The MAX77759 is a PMIC integrating, amongst others, a GPIO controller
including interrupt support for 2 GPIO lines.

- properties:
  - compatible:
    - const: maxim,max77759-gpio
  - #gpio-cells:
    - const: 2
  - gpio-controller: True
  - gpio-line-names:
    - minItems: 1
    - maxItems: 2
  - #interrupt-cells:
    - const: 2
  - interrupt-controller: True
- required:
  - compatible
  - #gpio-cells
  - gpio-controller
  - #interrupt-cells
  - interrupt-controller
- additionalProperties: False
```

## data/processed/linux-devicetree/Documentation/devicetree/bindings/gpio/mediatek,mt7621-gpio.txt
```
The D-Bus interface specification for 'linux-devicetree/Documentation/devicetree/bindings/gpio/mediatek,mt7621-gpio.yaml' is defined as follows:
Description: The IP core used inside these SoCs has 3 banks of 32 GPIOs each.
The registers of all the banks are interwoven inside one single IO range.
We load one GPIO controller instance per bank. Also the GPIO controller can receive
interrupts on any of the GPIOs, either edge or level. It then interrupts the CPU
using GIC INT12.
- $id: http://devicetree.org/schemas/gpio/mediatek,mt7621-gpio.yaml#
- $schema: http://devicetree.org/meta-schemas/core.yaml#
- title: Mediatek MT7621 SoC GPIO controller
- maintainers:
  - Sergio Paracuellos <sergio.paracuellos@gmail.com>
- description: The IP core used inside these SoCs has 3 banks of 32 GPIOs each.
The registers of all the banks are interwoven inside one single IO range.
We load one GPIO controller instance per bank. Also the GPIO controller can receive
interrupts on any of the GPIOs, either edge or level. It then interrupts the CPU
using GIC INT12.

- properties:
  - $nodename:
    - pattern: ^gpio@[0-9a-f]+$
  - compatible:
    - const: mediatek,mt7621-gpio
  - reg:
    - maxItems: 1
  - #gpio-cells:
    - const: 2
  - gpio-controller: True
  - gpio-ranges: True
  - interrupt-controller: True
  - #interrupt-cells:
    - const: 2
  - interrupts:
    - maxItems: 1
- required:
  - compatible
  - reg
  - #gpio-cells
  - gpio-controller
  - gpio-ranges
  - interrupt-controller
  - #interrupt-cells
  - interrupts
- additionalProperties: False
- examples:
  - #include <dt-bindings/gpio/gpio.h>
#include <dt-bindings/interrupt-controller/mips-gic.h>

gpio@600 {
  compatible = "mediatek,mt7621-gpio";
  reg = <0x600 0x100>;
  #gpio-cells = <2>;
  gpio-controller;
  gpio-ranges = <&pinctrl 0 0 95>;
  interrupt-controller;
  #interrupt-cells = <2>;
  interrupt-parent = <&gic>;
  interrupts = <GIC_SHARED 12 IRQ_TYPE_LEVEL_HIGH>;
};
```

## data/processed/linux-devicetree/Documentation/devicetree/bindings/gpio/microchip,pic32mzda-gpio.txt
```
The D-Bus interface specification for 'linux-devicetree/Documentation/devicetree/bindings/gpio/microchip,pic32mzda-gpio.yaml' is defined as follows:
- $id: http://devicetree.org/schemas/gpio/microchip,pic32mzda-gpio.yaml#
- $schema: http://devicetree.org/meta-schemas/core.yaml#
- title: Microchip PIC32 GPIO controller
- maintainers:
  - Joshua Henderson <joshua.henderson@microchip.com>
  - Purna Chandra Mandal <purna.mandal@microchip.com>
- properties:
  - compatible:
    - const: microchip,pic32mzda-gpio
  - reg:
    - maxItems: 1
  - gpio-controller: True
  - gpio-ranges: True
  - #gpio-cells:
    - const: 2
  - interrupts:
    - maxItems: 1
  - interrupt-controller: True
  - #interrupt-cells:
    - const: 2
  - clocks:
    - maxItems: 1
  - microchip,gpio-bank:
    - description: Bank index owned by the controller
    - $ref: /schemas/types.yaml#/definitions/uint32
- required:
  - compatible
  - reg
  - gpio-controller
  - gpio-ranges
  - #gpio-cells
  - interrupts
  - interrupt-controller
  - #interrupt-cells
  - clocks
  - microchip,gpio-bank
- additionalProperties: False
- examples:
  - #include <dt-bindings/interrupt-controller/irq.h>

gpio@1f860000 {
    compatible = "microchip,pic32mzda-gpio";
    reg = <0x1f860000 0x100>;
    interrupts = <118 IRQ_TYPE_LEVEL_HIGH>;
    #gpio-cells = <2>;
    gpio-controller;
    interrupt-controller;
    #interrupt-cells = <2>;
    clocks = <&rootclk 11>;
    microchip,gpio-bank = <0>;
    gpio-ranges = <&pic32_pinctrl 0 0 16>;
};
```

## data/processed/linux-devicetree/Documentation/devicetree/bindings/gpio/mstar,msc313-gpio.txt
```
The D-Bus interface specification for 'linux-devicetree/Documentation/devicetree/bindings/gpio/mstar,msc313-gpio.yaml' is defined as follows:
- $id: http://devicetree.org/schemas/gpio/mstar,msc313-gpio.yaml#
- $schema: http://devicetree.org/meta-schemas/core.yaml#
- title: MStar/SigmaStar GPIO controller
- maintainers:
  - Daniel Palmer <daniel@thingy.jp>
- properties:
  - $nodename:
    - pattern: ^gpio@[0-9a-f]+$
  - compatible:
    - enum:
      - mstar,msc313-gpio
      - sstar,ssd20xd-gpio
  - reg:
    - maxItems: 1
  - gpio-controller: True
  - #gpio-cells:
    - const: 2
  - gpio-ranges: True
  - interrupt-controller: True
  - #interrupt-cells:
    - const: 2
- required:
  - compatible
  - reg
  - gpio-controller
  - #gpio-cells
  - interrupt-controller
  - #interrupt-cells
- additionalProperties: False
- examples:
  - #include <dt-bindings/gpio/msc313-gpio.h>

gpio: gpio@207800 {
  compatible = "mstar,msc313-gpio";
  #gpio-cells = <2>;
  reg = <0x207800 0x200>;
  gpio-controller;
  gpio-ranges = <&pinctrl 0 36 22>,
                <&pinctrl 22 63 4>,
                <&pinctrl 26 68 6>;
  #interrupt-cells = <2>;
  interrupt-controller;
  interrupt-parent = <&intc_fiq>;
};
```

## data/processed/linux-devicetree/Documentation/devicetree/bindings/gpio/pl061-gpio.txt
```
The D-Bus interface specification for 'linux-devicetree/Documentation/devicetree/bindings/gpio/pl061-gpio.yaml' is defined as follows:
- $id: http://devicetree.org/schemas/gpio/pl061-gpio.yaml#
- $schema: http://devicetree.org/meta-schemas/core.yaml#
- title: ARM PL061 GPIO controller
- maintainers:
  - Linus Walleij <linus.walleij@linaro.org>
  - Rob Herring <robh@kernel.org>
- select:
  - properties:
    - compatible:
      - contains:
        - const: arm,pl061
  - required:
    - compatible
- properties:
  - $nodename:
    - pattern: ^gpio@[0-9a-f]+$
  - compatible:
    - items:
        - const: arm,pl061
        - const: arm,primecell
  - reg:
    - maxItems: 1
  - interrupts:
    - oneOf:
        - maxItems: 1
        - maxItems: 8
  - interrupt-controller: True
  - #interrupt-cells:
    - const: 2
  - clocks:
    - maxItems: 1
  - clock-names: True
  - #gpio-cells:
    - const: 2
  - gpio-controller: True
  - gpio-line-names: True
  - gpio-ranges:
    - minItems: 1
    - maxItems: 8
- required:
  - compatible
  - reg
  - clocks
  - #gpio-cells
  - gpio-controller
- additionalProperties: False
```

## data/processed/linux-devicetree/Documentation/devicetree/bindings/gpio/qca,ar7100-gpio.txt
```
The D-Bus interface specification for 'linux-devicetree/Documentation/devicetree/bindings/gpio/qca,ar7100-gpio.yaml' is defined as follows:
- $id: http://devicetree.org/schemas/gpio/qca,ar7100-gpio.yaml#
- $schema: http://devicetree.org/meta-schemas/core.yaml#
- title: Qualcomm Atheros AR7xxx/AR9xxx GPIO controller
- maintainers:
  - Alban Bedel <albeu@free.fr>
- properties:
  - compatible:
    - oneOf:
        - items:
            - const: qca,ar9132-gpio
            - const: qca,ar7100-gpio
        - enum:
          - qca,ar7100-gpio
          - qca,ar9340-gpio
  - reg:
    - maxItems: 1
  - gpio-controller: True
  - #gpio-cells:
    - const: 2
  - ngpios: True
  - interrupts:
    - maxItems: 1
  - interrupt-controller: True
  - #interrupt-cells:
    - const: 2
- required:
  - compatible
  - reg
  - gpio-controller
  - #gpio-cells
  - ngpios
- additionalProperties: False
- examples:
  - gpio@18040000 {
    compatible = "qca,ar9132-gpio", "qca,ar7100-gpio";
    reg = <0x18040000 0x30>;
    interrupts = <2>;
    ngpios = <22>;
    gpio-controller;
    #gpio-cells = <2>;
    interrupt-controller;
    #interrupt-cells = <2>;
};
```
