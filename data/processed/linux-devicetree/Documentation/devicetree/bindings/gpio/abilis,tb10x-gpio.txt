## data/processed/linux-devicetree/Documentation/devicetree/bindings/gpio/abilis,tb10x-gpio.txt
```
The D-Bus interface specification for 'linux-devicetree/Documentation/devicetree/bindings/gpio/abilis,tb10x-gpio.yaml' is defined as follows:
- $id: http://devicetree.org/schemas/gpio/abilis,tb10x-gpio.yaml#
- $schema: http://devicetree.org/meta-schemas/core.yaml#
- title: Abilis TB10x GPIO controller
- maintainers:
  - Christian Ruppert <christian.ruppert@abilis.com>
- properties:
  - compatible:
    - const: abilis,tb10x-gpio
  - reg:
    - maxItems: 1
  - gpio-controller: True
  - #gpio-cells:
    - const: 2
  - gpio-ranges: True
  - gpio-ranges-group-names: True
  - interrupt-controller: True
  - #interrupt-cells:
    - const: 1
    - description: Interrupts are triggered on both edges
  - interrupts:
    - maxItems: 1
  - abilis,ngpio:
    - description: Number of GPIO pins this driver controls
    - $ref: /schemas/types.yaml#/definitions/uint32
- required:
  - compatible
  - reg
  - gpio-controller
  - #gpio-cells
  - abilis,ngpio
- additionalProperties: False
- examples:
  - gpio@ff140000 {
    compatible = "abilis,tb10x-gpio";
    interrupt-controller;
    #interrupt-cells = <1>;
    interrupts = <27 2>;
    reg = <0xff140000 0x1000>;
    gpio-controller;
    #gpio-cells = <2>;
    abilis,ngpio = <3>;
    gpio-ranges = <&iomux 0 0 0>;
    gpio-ranges-group-names = "gpioa_pins";
};
```

## data/processed/linux-devicetree/Documentation/devicetree/bindings/gpio/adi,ds4520-gpio.txt
```
The D-Bus interface specification for 'linux-devicetree/Documentation/devicetree/bindings/gpio/adi,ds4520-gpio.yaml' is defined as follows:
- $id: http://devicetree.org/schemas/gpio/adi,ds4520-gpio.yaml#
- $schema: http://devicetree.org/meta-schemas/core.yaml#
- title: DS4520 I2C GPIO expander
- maintainers:
  - Okan Sahin <okan.sahin@analog.com>
- properties:
  - compatible:
    - enum:
      - adi,ds4520-gpio
  - reg:
    - maxItems: 1
  - gpio-controller: True
  - #gpio-cells:
    - const: 2
  - ngpios:
    - minimum: 1
    - maximum: 9
- required:
  - compatible
  - reg
  - gpio-controller
  - #gpio-cells
  - ngpios
- additionalProperties: False
- examples:
  - i2c {
    #address-cells = <1>;
    #size-cells = <0>;

    gpio@50 {
        compatible = "adi,ds4520-gpio";
        reg = <0x50>;
        ngpios = <9>;
        gpio-controller;
        #gpio-cells = <2>;
    };
};
```

## data/processed/linux-devicetree/Documentation/devicetree/bindings/gpio/altr-pio-1.0.txt
```
The D-Bus interface specification for 'linux-devicetree/Documentation/devicetree/bindings/gpio/altr-pio-1.0.yaml' is defined as follows:
- $id: http://devicetree.org/schemas/gpio/altr-pio-1.0.yaml#
- $schema: http://devicetree.org/meta-schemas/core.yaml#
- title: Altera GPIO controller
- maintainers:
  - Dinh Nguyen <dinguyen@kernel.org>
  - Marek Vasut <marex@denx.de>
  - Mathieu Malaterre <malat@debian.org>
  - Tien Hock Loh <thloh@altera.com>
- properties:
  - compatible:
    - const: altr,pio-1.0
  - reg:
    - maxItems: 1
  - gpio-controller: True
  - #gpio-cells:
    - const: 2
    - description: First cell is the GPIO offset number. Second cell is reserved and currently unused.
  - interrupts:
    - maxItems: 1
  - interrupt-controller: True
  - #interrupt-cells:
    - const: 2
  - altr,ngpio:
    - $ref: /schemas/types.yaml#/definitions/uint32
    - description: Width of the GPIO bank.
    - default: 32
  - altr,interrupt-type:
    - $ref: /schemas/types.yaml#/definitions/uint32
    - description: Specifies the interrupt trigger type synthesized by hardware. Values defined in <dt-bindings/interrupt-controller/irq.h>.

    - enum:
      - 1
      - 2
      - 3
      - 4
- required:
  - compatible
  - reg
  - gpio-controller
  - #gpio-cells
  - interrupts
  - interrupt-controller
  - #interrupt-cells
- additionalProperties: False
- examples:
  - #include <dt-bindings/interrupt-controller/irq.h>

gpio@ff200000 {
    compatible = "altr,pio-1.0";
    reg = <0xff200000 0x10>;
    interrupts = <45 4>;
    interrupt-controller;
    #interrupt-cells = <2>;
    gpio-controller;
    #gpio-cells = <2>;
    altr,ngpio = <32>;
    altr,interrupt-type = <IRQ_TYPE_EDGE_RISING>;
};
```

## data/processed/linux-devicetree/Documentation/devicetree/bindings/gpio/apple,smc-gpio.txt
```
The D-Bus interface specification for 'linux-devicetree/Documentation/devicetree/bindings/gpio/apple,smc-gpio.yaml' is defined as follows:
Description: Apple Mac System Management Controller GPIO block.
- $id: http://devicetree.org/schemas/gpio/apple,smc-gpio.yaml#
- $schema: http://devicetree.org/meta-schemas/core.yaml#
- title: Apple Mac System Management Controller GPIO
- maintainers:
  - Sven Peter <sven@kernel.org>
- description: Apple Mac System Management Controller GPIO block.
- properties:
  - compatible:
    - const: apple,smc-gpio
  - gpio-controller: True
  - #gpio-cells:
    - const: 2
- required:
  - compatible
  - gpio-controller
  - #gpio-cells
- additionalProperties: False
```

## data/processed/linux-devicetree/Documentation/devicetree/bindings/gpio/cdns,gpio.txt
```
The D-Bus interface specification for 'linux-devicetree/Documentation/devicetree/bindings/gpio/cdns,gpio.yaml' is defined as follows:
- $id: http://devicetree.org/schemas/gpio/cdns,gpio.yaml#
- $schema: http://devicetree.org/meta-schemas/core.yaml#
- title: Cadence GPIO Controller
- maintainers:
  - Jan Kotas <jank@cadence.com>
- properties:
  - compatible:
    - oneOf:
        - const: cdns,gpio-r1p02
        - items:
            - enum:
              - axiado,ax3000-gpio
            - const: cdns,gpio-r1p02
  - reg:
    - maxItems: 1
  - clocks:
    - maxItems: 1
  - ngpios:
    - minimum: 1
    - maximum: 32
  - gpio-controller: True
  - #gpio-cells:
    - const: 2
    - description: - First cell is the GPIO line number.
- Second cell is flags as defined in <dt-bindings/gpio/gpio.h>,
  only GPIO_ACTIVE_HIGH and GPIO_ACTIVE_LOW supported.

  - interrupt-controller: True
  - #interrupt-cells:
    - const: 2
    - description: - First cell is the GPIO line number used as IRQ.
- Second cell is the trigger type, as defined in
  <dt-bindings/interrupt-controller/irq.h>.

  - interrupts:
    - maxItems: 1
- required:
  - compatible
  - reg
  - clocks
  - gpio-controller
  - #gpio-cells
- if:
  - required:
    - interrupt-controller
- then:
  - required:
    - interrupts
- additionalProperties: False
- examples:
  - #include <dt-bindings/interrupt-controller/arm-gic.h>
#include <dt-bindings/interrupt-controller/irq.h>
gpio0: gpio-controller@fd060000 {
    compatible = "cdns,gpio-r1p02";
    reg = <0xfd060000 0x1000>;
    clocks = <&gpio_clk>;

    interrupt-parent = <&gic>;
    interrupts = <GIC_SPI 5 IRQ_TYPE_LEVEL_HIGH>;

    gpio-controller;
    #gpio-cells = <2>;

    interrupt-controller;
    #interrupt-cells = <2>;
};
```

## data/processed/linux-devicetree/Documentation/devicetree/bindings/gpio/exar,xra1403.txt
```
The D-Bus interface specification for 'linux-devicetree/Documentation/devicetree/bindings/gpio/exar,xra1403.yaml' is defined as follows:
Description: The XRA1403 is an 16-bit GPIO expander with an SPI interface. Features available:

  - Individually programmable inputs:
      - Internal pull-up resistors
      - Polarity inversion
      - Individual interrupt enable
      - Rising edge and/or Falling edge interrupt
      - Input filter
  - Individually programmable outputs:
      - Output Level Control
      - Output Three-State Control
- $id: http://devicetree.org/schemas/gpio/exar,xra1403.yaml#
- $schema: http://devicetree.org/meta-schemas/core.yaml#
- title: XRA1403 16-bit GPIO Expander with Reset Input
- maintainers:
  - Nandor Han <nandor.han@ge.com>
- description: The XRA1403 is an 16-bit GPIO expander with an SPI interface. Features available:

  - Individually programmable inputs:
      - Internal pull-up resistors
      - Polarity inversion
      - Individual interrupt enable
      - Rising edge and/or Falling edge interrupt
      - Input filter
  - Individually programmable outputs:
      - Output Level Control
      - Output Three-State Control

- properties:
  - compatible:
    - const: exar,xra1403
  - reg:
    - maxItems: 1
  - gpio-controller: True
  - #gpio-cells:
    - const: 2
  - interrupt-controller: True
  - #interrupt-cells:
    - const: 2
  - reset-gpios:
    - description: Control line for the device reset.
- required:
  - compatible
  - reg
  - gpio-controller
  - #gpio-cells
- allOf:
    - $ref: /schemas/spi/spi-peripheral-props.yaml#
- unevaluatedProperties: False
- examples:
  - #include <dt-bindings/gpio/gpio.h>

spi {
    #address-cells = <1>;
    #size-cells = <0>;

    gpio@2 {
        compatible = "exar,xra1403";
        reg = <2>;
        spi-max-frequency = <1000000>;
        gpio-controller;
        #gpio-cells = <2>;
        interrupt-controller;
        #interrupt-cells = <2>;
        reset-gpios = <&gpio3 6 GPIO_ACTIVE_LOW>;
    };
};
```

## data/processed/linux-devicetree/Documentation/devicetree/bindings/gpio/fsl,imx8qxp-sc-gpio.txt
```
The D-Bus interface specification for 'linux-devicetree/Documentation/devicetree/bindings/gpio/fsl,imx8qxp-sc-gpio.yaml' is defined as follows:
Description: This module provides the standard interface to control the
resource pins in SCU domain on i.MX8 platforms.
- $id: http://devicetree.org/schemas/gpio/fsl,imx8qxp-sc-gpio.yaml#
- $schema: http://devicetree.org/meta-schemas/core.yaml#
- title: GPIO driver over IMX SCU firmware API
- maintainers:
  - Shenwei Wang <shenwei.wang@nxp.com>
- description: This module provides the standard interface to control the
resource pins in SCU domain on i.MX8 platforms.

- properties:
  - compatible:
    - enum:
      - fsl,imx8qxp-sc-gpio
  - #gpio-cells:
    - const: 2
  - gpio-controller: True
- required:
  - compatible
  - #gpio-cells
  - gpio-controller
- additionalProperties: False
- examples:
  - gpio0: gpio {
    compatible = "fsl,imx8qxp-sc-gpio";
    gpio-controller;
    #gpio-cells = <2>;
};
```

## data/processed/linux-devicetree/Documentation/devicetree/bindings/gpio/fujitsu,mb86s70-gpio.txt
```
The D-Bus interface specification for 'linux-devicetree/Documentation/devicetree/bindings/gpio/fujitsu,mb86s70-gpio.yaml' is defined as follows:
- $id: http://devicetree.org/schemas/gpio/fujitsu,mb86s70-gpio.yaml#
- $schema: http://devicetree.org/meta-schemas/core.yaml#
- title: Fujitsu MB86S7x GPIO Controller
- maintainers:
  - Jassi Brar <jaswinder.singh@linaro.org>
- properties:
  - compatible:
    - oneOf:
        - items:
            - const: socionext,synquacer-gpio
            - const: fujitsu,mb86s70-gpio
        - const: fujitsu,mb86s70-gpio
  - reg:
    - maxItems: 1
  - #gpio-cells:
    - const: 2
  - gpio-controller: True
  - gpio-line-names: True
  - clocks:
    - maxItems: 1
- required:
  - compatible
  - reg
  - #gpio-cells
  - gpio-controller
  - clocks
- additionalProperties: False
- examples:
  - gpio@31000000 {
    compatible = "fujitsu,mb86s70-gpio";
    reg = <0x31000000 0x10000>;
    gpio-controller;
    #gpio-cells = <2>;
    clocks = <&clk 0 2 1>;
};
```

## data/processed/linux-devicetree/Documentation/devicetree/bindings/gpio/gpio-consumer-common.txt
```
The D-Bus interface specification for 'linux-devicetree/Documentation/devicetree/bindings/gpio/gpio-consumer-common.yaml' is defined as follows:
Description: Pay attention to using proper GPIO flag (e.g. GPIO_ACTIVE_LOW) for the GPIOs using inverted signal (e.g. RESETN).
- $id: http://devicetree.org/schemas/gpio/gpio-consumer-common.yaml#
- $schema: http://devicetree.org/meta-schemas/core.yaml#
- title: Common GPIO lines
- maintainers:
  - Bartosz Golaszewski <brgl@bgdev.pl>
  - Linus Walleij <linus.walleij@linaro.org>
- description: Pay attention to using proper GPIO flag (e.g. GPIO_ACTIVE_LOW) for the GPIOs using inverted signal (e.g. RESETN).
- select: True
- properties:
  - enable-gpios:
    - maxItems: 1
    - description: GPIO connected to the enable control pin.
  - reset-gpios:
    - description: GPIO (or GPIOs for power sequence) connected to the device reset pin (e.g. RESET or RESETN).
  - powerdown-gpios:
    - maxItems: 1
    - description: GPIO connected to the power down pin (hardware power down or power cut, e.g. PD or PWDN).
  - pwdn-gpios:
    - maxItems: 1
    - description: Use powerdown-gpios
    - deprecated: True
  - wakeup-gpios:
    - maxItems: 1
    - description: GPIO connected to the pin waking up the device from suspend or other power-saving modes.
- allOf:
    - if:
      - properties:
        - compatible:
          - contains:
            - enum:
              - mmc-pwrseq-simple
    - then:
      - properties:
        - reset-gpios:
          - minItems: 1
          - maxItems: 32
    - else:
      - properties:
        - reset-gpios:
          - maxItems: 1
- additionalProperties: True
```

## data/processed/linux-devicetree/Documentation/devicetree/bindings/gpio/gpio-rda.txt
```
The D-Bus interface specification for 'linux-devicetree/Documentation/devicetree/bindings/gpio/gpio-rda.yaml' is defined as follows:
- $id: http://devicetree.org/schemas/gpio/gpio-rda.yaml#
- $schema: http://devicetree.org/meta-schemas/core.yaml#
- title: RDA Micro GPIO controller
- maintainers:
  - Manivannan Sadhasivam <manivannan.sadhasivam@linaro.org>
- properties:
  - compatible:
    - const: rda,8810pl-gpio
  - reg:
    - maxItems: 1
  - gpio-controller: True
  - #gpio-cells:
    - const: 2
  - ngpios:
    - description: Number of available gpios in a bank.
    - minimum: 1
    - maximum: 32
  - interrupt-controller: True
  - #interrupt-cells:
    - const: 2
  - interrupts:
    - maxItems: 1
- required:
  - compatible
  - reg
  - gpio-controller
  - #gpio-cells
  - ngpios
  - interrupt-controller
  - #interrupt-cells
  - interrupts
- additionalProperties: False
```

## data/processed/linux-devicetree/Documentation/devicetree/bindings/gpio/gpio-virtio.txt
```
The D-Bus interface specification for 'linux-devicetree/Documentation/devicetree/bindings/gpio/gpio-virtio.yaml' is defined as follows:
Description: Virtio GPIO controller, see /schemas/virtio/virtio-device.yaml for more details.
- $id: http://devicetree.org/schemas/gpio/gpio-virtio.yaml#
- $schema: http://devicetree.org/meta-schemas/core.yaml#
- title: Virtio GPIO controller
- maintainers:
  - Viresh Kumar <viresh.kumar@linaro.org>
- allOf:
    - $ref: /schemas/virtio/virtio-device.yaml#
- description: Virtio GPIO controller, see /schemas/virtio/virtio-device.yaml for more details.
- properties:
  - $nodename:
    - const: gpio
  - compatible:
    - const: virtio,device29
  - gpio-controller: True
  - #gpio-cells:
    - const: 2
  - interrupt-controller: True
  - #interrupt-cells:
    - const: 2
- required:
  - compatible
  - gpio-controller
  - #gpio-cells
- unevaluatedProperties: False
- examples:
  - virtio@3000 {
    compatible = "virtio,mmio";
    reg = <0x3000 0x100>;
    interrupts = <41>;

    gpio {
        compatible = "virtio,device29";
        gpio-controller;
        #gpio-cells = <2>;
        interrupt-controller;
        #interrupt-cells = <2>;
    };
};
```
